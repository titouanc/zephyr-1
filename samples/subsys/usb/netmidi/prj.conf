## CMakeLists.txt
```
# SPDX-License-Identifier: Apache-2.0

cmake_minimum_required(VERSION 3.20.0)
find_package(Zephyr REQUIRED HINTS $ENV{ZEPHYR_BASE})
project(usb_midi)

include(${ZEPHYR_BASE}/samples/subsys/usb/common/common.cmake)
include(${ZEPHYR_BASE}/samples/net/common/common.cmake)

FILE(GLOB app_sources src/*.c)
target_sources(app PRIVATE ${app_sources})
```

## Kconfig
```
# Copyright (c) 2024 Titouan Christophe
# SPDX-License-Identifier: Apache-2.0

# Source common USB sample options used to initialize new experimental USB
# device stack. The scope of these options is limited to USB samples in project
# tree, you cannot use them in your own application.
source "samples/subsys/usb/common/Kconfig.sample_usbd"

config NET_SAMPLE_MIDI_HOST_PORT
	int "Host port"
	default 45486

source "Kconfig.zephyr"
```

## prj.conf
```kconfig
CONFIG_USB_DEVICE_STACK_NEXT=y
CONFIG_CDC_ACM_SERIAL_INITIALIZE_AT_BOOT=n
CONFIG_USBD_MIDI2_CLASS=y

CONFIG_SAMPLE_USBD_PRODUCT="USBD MIDI Sample"
CONFIG_SAMPLE_USBD_PID=0x0010

CONFIG_INPUT=y

CONFIG_LOG=y
CONFIG_NET_LOG=y
CONFIG_USBD_LOG_LEVEL_WRN=y
CONFIG_UDC_DRIVER_LOG_LEVEL_WRN=y


CONFIG_NETWORKING=y
CONFIG_ZVFS_POLL_MAX=4
CONFIG_NET_CONFIG_SETTINGS=y
CONFIG_NET_CONFIG_NEED_IPV4=y
CONFIG_NET_HOSTNAME_ENABLE=y

CONFIG_NETMIDI2_HOST=y

CONFIG_TEST_RANDOM_GENERATOR=y

CONFIG_DNS_RESOLVER=y
CONFIG_MDNS_RESOLVER=y
CONFIG_DNS_RESOLVER_PACKET_FORWARDING=y
```

## app.overlay
```dts
/*
 * Copyright (c) 2024 Titouan Christophe
 *
 * SPDX-License-Identifier: Apache-2.0
 */

/ {
	usb_midi: usb_midi {
		compatible = "zephyr,midi2-device";
		status = "okay";
		#address-cells = <1>;
		#size-cells = <1>;
		label = "Zephyr USB-MIDI Sample";

		midi_in_out@0 {
			reg = <0 16>;
			protocol = "midi2";
		};
	};
};
```

## src/main.c
```c
/*
 * Copyright (c) 2025 Titouan Christophe
 *
 * SPDX-License-Identifier: Apache-2.0
 */

#include <zephyr/device.h>
#include <zephyr/net/midi2.h>
#include <zephyr/shell/shell.h>
#include <zephyr/usb/class/usbd_midi2.h>

#include <sample_usbd.h>
#include "discovery.h"

#include <zephyr/logging/log.h>
LOG_MODULE_REGISTER(sample_usb_net_midi, LOG_LEVEL_INF);

static struct usbd_context *sample_usbd = NULL;
static const struct device *const usb_midi = DEVICE_DT_GET(DT_NODELABEL(usb_midi));

static struct netmidi2_session *established_session = NULL;
NETMIDI2_EP_CLIENT_DEFINE(net_midi, "Zephyr MIDI USB<>Network", NULL, 0);

static void rx_usb_midi(const struct device *dev, const struct midi_ump ump)
{
	if (established_session != NULL) {
		netmidi2_send(established_session, ump);
	}
}

static void endpoint_found(const struct netmidi2_disc_ep *srv)
{
	if (! srv->has_address) {
		LOG_WRN("No IP address for endpoint %s", srv->target);
		return;
	}

	if (! srv->has_port) {
		LOG_WRN("No port for endpoint %s", srv->target);
		return;
	}

	LOG_INF("Found %s @ %d.%d.%d.%d:%d",
		srv->target,
		srv->addr.sin_addr.s4_addr[0], srv->addr.sin_addr.s4_addr[1],
		srv->addr.sin_addr.s4_addr[2], srv->addr.sin_addr.s4_addr[3],
		ntohs(srv->addr.sin_port));

	stop_discovery();
	netmidi2_ep_invite(&net_midi, (struct net_sockaddr *) &srv->addr,
			   sizeof(struct net_sockaddr_in));
}

static void rx_net_midi(struct netmidi2_session *session, const struct midi_ump ump)
{
	usbd_midi_send(usb_midi, ump);
}

static void session_established(struct netmidi2_session *session)
{
	established_session = session;
	if (usbd_enable(sample_usbd)) {
		LOG_ERR("Failed to enable USB");
	} else {
		LOG_INF("USB enabled");
	}
}

static void session_closed(struct netmidi2_session *session)
{
	if (usbd_disable(sample_usbd)) {
		LOG_ERR("Failed to disable USB");
	} else {
		LOG_INF("USB disabled");
	}
	established_session = NULL;
	start_discovery(endpoint_found);
}

int main(void)
{
	sample_usbd = sample_usbd_init_device(NULL);
	if (sample_usbd == NULL) {
		LOG_ERR("Failed to initialize USB device");
		return -1;
	}

	usbd_midi_set_ops(usb_midi, &((const struct usbd_midi_ops) {
		.rx_packet_cb = rx_usb_midi,
	}));

	netmidi2_set_ops(&net_midi, &((const struct netmidi2_ops) {
		.rx_packet_cb = rx_net_midi,
		.session_established_cb = session_established,
		.session_closed_cb = session_closed,
	}));
	netmidi2_host_ep_start(&net_midi);

	start_discovery(endpoint_found);

	return 0;
}

int cmd_midi2_discover(const struct shell *sh, int argc, char *argv[])
{
	if (argc > 1) {
		if (argv[1][0] == '0') {
			stop_discovery();
		} else if (argv[1][0] == '1') {
			start_discovery(endpoint_found);
		} else {
			shell_print(sh, "Usage: %s [ 0/1 ]\n", argv[0]);
			return -ENOEXEC;
		}
	}
	shell_print(sh, "Discovery %s",
		    is_discovery_started() ? "started" : "stopped");
	return 0;
}

int cmd_midi2_current(const struct shell *sh, int argc, char *argv[])
{
	if (established_session == NULL) {
		shell_print(sh, "No established session");
	} else {
		struct net_sockaddr *addr = net_sad(&established_session->addr);
		struct net_sockaddr_in6 *addr6 = net_sin6(addr);
		char peer[NET_INET6_ADDRSTRLEN];

		net_addr_ntop(addr->sa_family, &addr6->sin6_addr, peer, sizeof(peer));
		shell_print(sh, "Session established to %s:%d", peer, ntohs(addr6->sin6_port));
	}

	return 0;
}

int cmd_midi2_bye(const struct shell *sh, int argc, char *argv[])
{
	if (established_session == NULL) {
		shell_print(sh, "No established session");
	} else {
		netmidi2_session_bye(established_session);
	}

	return 0;
}

/* Creating subcommands (level 1 command) array for command "demo". */
SHELL_STATIC_SUBCMD_SET_CREATE(sub_midi2,
	SHELL_CMD(discover, NULL,
		  "Discover MIDI2.0 endpoints on the local network",
		  cmd_midi2_discover),
	SHELL_CMD(current, NULL,
		  "Print current session (if any)",
		  cmd_midi2_current),
	SHELL_CMD(bye, NULL,
		  "Bye (disconnect) current session",
		  cmd_midi2_bye),
	SHELL_SUBCMD_SET_END
);

/* Creating root (level 0) command "demo" */
SHELL_CMD_REGISTER(midi2, &sub_midi2, "Demo commands", NULL);
```

## src/discovery.c
```c
/*
 * Copyright (c) 2025 Titouan Christophe
 *
 * SPDX-License-Identifier: Apache-2.0
 */

#include <zephyr/net/dns_resolve.h>

#include "discovery.h"

#include <zephyr/logging/log.h>
LOG_MODULE_REGISTER(unmidi_disc, LOG_LEVEL_INF);

struct disc_state {
	struct k_work_delayable work;
	bool discovery_enabled;
	bool cb_called;
	uint16_t discovery_id;
	struct netmidi2_disc_ep srv;
	ep_found_cb cb;
};

void extract_dns_info(struct dns_addrinfo *info, struct netmidi2_disc_ep *srv)
{
	if (info->ai_family == NET_AF_INET) {
		uint16_t port = srv->addr.sin_port;
		memcpy(&srv->addr, &info->ai_addr, info->ai_addrlen);
		srv->addr.sin_port = port;
		srv->has_address = true;
	} else if (info->ai_family == AF_UNSPEC) {
		if (info->ai_extension == DNS_RESOLVE_SRV) {
			srv->addr.sin_port = htons(info->ai_srv.port);
			memcpy(srv->target, info->ai_srv.target, info->ai_srv.targetlen);
			srv->has_port = true;
		}
	}
}

static void dns_result_cb(enum dns_resolve_status status,
			  struct dns_addrinfo *info,
			  void *user_data)
{
	struct disc_state *state = user_data;

	if (status == DNS_EAI_INPROGRESS) {
		extract_dns_info(info, &state->srv);
	}

	if (status == DNS_EAI_ALLDONE || (state->srv.has_address && state->srv.has_port)) {
		if (state->cb && ! state->cb_called) {
			state->cb(&state->srv);
		}
		state->cb_called = true;
	}

	if (status != DNS_EAI_INPROGRESS) {
		k_work_reschedule(&state->work, K_MSEC(CONFIG_NETMIDI2_DISCOVER_RETRY_DELAY));
	}
}

static void discovery_work_fn(struct k_work *work)
{
	struct k_work_delayable *dwork = k_work_delayable_from_work(work);
	struct disc_state *state = CONTAINER_OF(dwork, struct disc_state, work);
	struct dns_resolve_context *resolver = dns_resolve_get_default();

	if (! state->discovery_enabled) {
		return;
	}

	state->cb_called = false;
	memset(&state->srv, 0, sizeof(struct netmidi2_disc_ep));
	dns_resolve_service(resolver, "_midi2._udp.local", &state->discovery_id,
			    dns_result_cb, state, CONFIG_NETMIDI2_DISCOVER_TIMEOUT * MSEC_PER_SEC);
}

static struct disc_state global_disc_state;

void start_discovery(ep_found_cb cb)
{
	if (global_disc_state.discovery_enabled) {
		LOG_INF("Discovery is already started");
		return;
	}

	LOG_INF("Starting discovery");
	global_disc_state.cb = cb;
	global_disc_state.discovery_enabled = true;
	k_work_init_delayable(&global_disc_state.work, discovery_work_fn);
	k_work_reschedule(&global_disc_state.work, K_NO_WAIT);
}

void stop_discovery()
{
	LOG_INF("Stopping discovery");
	global_disc_state.discovery_enabled = false;
	k_work_cancel_delayable(&global_disc_state.work);
}

bool is_discovery_started()
{
	return global_disc_state.discovery_enabled;
}
```

## src/discovery.h
```c
#ifndef SAMPLE_USB_NETMIDI_DISCOVERY_H_
#define SAMPLE_USB_NETMIDI_DISCOVERY_H_

struct netmidi2_disc_ep {
	bool has_address;
	bool has_port;
	struct net_sockaddr_in addr;
	char target[128];
};

typedef void (*ep_found_cb)(const struct netmidi2_disc_ep *disc);

void start_discovery(ep_found_cb cb);

void stop_discovery();

bool is_discovery_started();

#endif
```

/*
 * Copyright (c) 2024 Titouan Christophe
 *
 * SPDX-License-Identifier: Apache-2.0
 */

#include <zephyr/dt-bindings/led/led.h>

&arduino_i2c {
	neotrellis: seesaw@2e {
		compatible = "adafruit,seesaw";
		reg = <0x2e>;
		status = "okay";

		neotrellis_keypad: seesaw-keypad {
			compatible = "adafruit,seesaw-keypad";
			status = "okay";
		};

		neotrellis_neopixel: seesaw-neopixel {
			compatible = "adafruit,seesaw-neopixel";
			status = "okay";
			output-pin = <3>;
			chain-length = <16>;
			color-mapping = <LED_COLOR_ID_GREEN LED_COLOR_ID_RED LED_COLOR_ID_BLUE>;
		};
	};
};

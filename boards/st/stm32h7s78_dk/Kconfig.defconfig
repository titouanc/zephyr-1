## boards/st/stm32h7s78_dk/Kconfig.defconfig
```kconfig
# STM32H7S78 DISCOVERY KIT board configuration
#
# Copyright (c) 2024 STMicroelectronics
#
# SPDX-License-Identifier: Apache-2.0
#

if BOARD_STM32H7S78_DK

if NETWORKING
config NET_L2_ETHERNET
	default y
endif # NETWORKING

if DISPLAY
config MEMC
	# Framebuffer is in PSRAM which needs the memory controller
	default y
endif # DISPLAY

endif # BOARD_STM32H7S78_DK
```

## drivers/audio/Kconfig.cs47l63
```kconfig
# Copyright (c) 2025 Titouan Christophe
# SPDX-License-Identifier: Apache-2.0

config AUDIO_CODEC_CS47L63
	bool "Cirrus CS47L63 driver"
	default y
	select SPI
	depends on DT_HAS_CIRRUS_CS47L63_ENABLED
	help
	  Enable the driver for the Cirrus CS47L63 Low-Power Audio DSP
	  with Microphone Interface and Mono Differential Headphone Driver
```

## drivers/gpio/Kconfig.seesaw
```kconfig
# Copyright 2025 Titouan Chrisotphe
# SPDX-License-Identifier: Apache-2.0

config GPIO_SEESAW
	bool "Adafruit Seesaw GPIO over I2C"
	default y
	depends on MFD_SEESAW
	depends on DT_HAS_ADAFRUIT_SEESAW_GPIO_ENABLED
	help
	  Enable support for Adafruit Seesaw gpio
```

## drivers/input/Kconfig.seesaw_keypad
```kconfig
# Copyright (c) 2025 Titouan Christophe
# SPDX-License-Identifier: Apache-2.0

config INPUT_SEESAW_KEYPAD
	bool "Adafruit seesaw keypad over I2C"
	default y
	depends on DT_HAS_ADAFRUIT_SEESAW_KEYPAD_ENABLED
	depends on MFD_SEESAW
	help
	  Enable support for Adafruit Seesaw gpio

if INPUT_SEESAW_KEYPAD

config INPUT_SEESAW_KEYPAD_POLL_INTERVAL
	int "Event poll interval (ms)"
	default 25

endif
```

## drivers/led/Kconfig.seesaw_neopixel
```kconfig
# Copyright 2025 Titouan Chrisotphe
# SPDX-License-Identifier: Apache-2.0

config SEESAW_NEOPIXEL
	bool "Adafruit Seesaw neopixel leds over I2C"
	default y
	depends on MFD_SEESAW
	depends on DT_HAS_ADAFRUIT_SEESAW_NEOPIXEL_ENABLED
	help
	  Enable support for Adafruit Seesaw neopixel leds
```

## drivers/mfd/Kconfig.seesaw
```kconfig
# Copyright (c) 2025 Titouan Christophe
# SPDX-License-Identifier: Apache-2.0

config MFD_SEESAW
	bool "Adafruit Seesaw multifunction device"
	default y
	depends on DT_HAS_ADAFRUIT_SEESAW_ENABLED
	help
	  Enable driver for Adafruit Seesaw.

if MFD_SEESAW

module = MFD_SEESAW
module-str = seesaw
source "subsys/logging/Kconfig.template.log_config"

endif
```

## drivers/misc/adafruit_seesaw/Kconfig
```kconfig
# Copyright (c) 2024 Titouan Christophe
# SPDX-License-Identifier: Apache-2.0

config ADAFRUIT_SEESAW
	bool "Adafruit Seesaw module"
	default y
	depends on I2C && DT_HAS_ADAFRUIT_SEESAW_ENABLED
	help
	  Enable support for Adafruit seesaw module (core driver)
```

## drivers/pwm/Kconfig.seesaw
```kconfig
# Copyright 2025 Titouan Chrisotphe
# SPDX-License-Identifier: Apache-2.0

config PWM_SEESAW
	bool "Adafruit Seesaw PWM over I2C"
	default y
	depends on MFD_SEESAW
	depends on DT_HAS_ADAFRUIT_SEESAW_PWM_ENABLED
	help
	  Enable support for Adafruit Seesaw pwm
```

## dts/bindings/mfd/adafruit,seesaw.yaml
```yaml
# Copyright (C) 2025 Titouan Christophe
# SPDX-License-Identifier: Apache-2.0

description: Adafruit Seesaw

compatible: "adafruit,seesaw"

include: [i2c-device.yaml]
```

## dts/bindings/usb/zephyr,usb-midi.yaml
```yaml
# Copyright (c) 2024 Titouan Christophe
# SPDX-License-Identifier: Apache-2.0

description: USB MIDI Class

compatible: "zephyr,usb-midi"
```

## samples/drivers/display/boards/stm32h7s78_dk.conf
```kconfig
# Copyright (c) 2025 Titouan Christophe
# SPDX-License-Identifier: Apache-2.0

# On STM32H7S78-DK board, display being larger (800x480), it requires
# more memory to draw squares on the display (~40kiB)
CONFIG_HEAP_MEM_POOL_SIZE=65536
```

## samples/drivers/i2s/i2s_codec/boards/stm32h7s78_dk.conf
```kconfig
# Copyright 2025 Titouan Christophe
# SPDX-License-Identifier: Apache-2.0

CONFIG_SAMPLE_FREQ=5512
```

## subsys/midi2/Kconfig
```kconfig
# Copyright (c) 2025 Titouan Christophe
# SPDX-License-Identifier: Apache-2.0

menu "MIDI2 subsystem"

config MIDI2_UMP_STREAM_RESPONDER
	bool "MIDI2 UMP Stream responder"

endmenu
```

## subsys/net/lib/midi2/Kconfig
```kconfig
# Copyright (c) 2025 Titouan Christophe
# SPDX-License-Identifier: Apache-2.0

config MIDI2_UDP_HOST
	bool "MIDI2 UDP host [EXPERIMENTAL]"
	select NET_SOCKETS
	select NET_IPV4
	select NET_UDP
	help
	  Host library of User Datagram Protocol for Universal MIDI Packets.
	  Provides the following features:
	  - Exposing UMP endpoint exposed on UDP socket
	  - Accepting inbound client invitations
	  - Sending/Receiving Universal MIDI packets
	  Following "Network MIDI 2.0 (UDP) Transport Specification" v1.0

if MIDI2_UDP_HOST
config MIDI2_UDP_HOST_AUTH
	bool "Support for authentication (shared key or user/password)"
	select MBEDTLS
	select MBEDTLS_CIPHER_CCM_ENABLED
	select CRYPTO
	select CRYPTO_MBEDTLS_SHIM

module=NET_MIDI2
module-dep=NET_LOG
module-str=Log level for network MIDI2
module-help=Enables midi2 debug messages.
source "subsys/net/Kconfig.template.log_config.net"
endif

config MIDI2_UMP_STREAM_RESPONDER
	bool "MIDI2 UMP Stream responder"
	help
	  Library to respond to UMP Stream discovery messages, as specified
	  in "Universal MIDI Packet (UMP) Format and MIDI 2.0 Protocol"
	  version 1.1.2 section 7.1: "UMP Stream Messages"
```

## subsys/usb/device_next/class/Kconfig.midi
```kconfig
# Copyright (c) 2024 Titouan Christophe
#
# SPDX-License-Identifier: Apache-2.0

config USBD_MIDI_CLASS
	bool "USB MIDI class support [EXPERIMENTAL]"
	help
	  USB MIDI device class support.

if USBD_MIDI_CLASS

config USBD_MIDI_CLASS_MIDI2
	bool "USB-MIDI2.0 alternate setting"
	help
	  Make a USB-MIDI 2.0 interface, in addition to the backward-compatible
	  USB-MIDI 1.0 interface.

module = USBD_MIDI
module-str = usbd midi
source "subsys/logging/Kconfig.template.log_config"

endif
```
